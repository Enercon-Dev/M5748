# file: M5748-BL.ioc
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Mcu.Family=STM32F1
Mcu.Name=STM32F103C(8-B)Tx
Mcu.Package=LQFP48
NVIC.PriorityGroup=NVIC_PRIORITYGROUP_4
PA13.Mode=Serial_Wire
PA13.Signal=SYS_JTMS-SWDIO
PA14.Mode=Serial_Wire
PA14.Signal=SYS_JTCK-SWCLK
ProjectManager.HeapSize=0x200
ProjectManager.StackSize=0x400
ProjectManager.TargetToolchain=EWARM V8.32
RCC.APB1Freq_Value=8000000
RCC.APB2Freq_Value=8000000
board=custom

// file: Core/Src/main.c
/* USER CODE BEGIN Header */
/**
  ******************************************************************************
  * @file           : main.c
  * @brief          : Main program body
  ******************************************************************************
  * @attention
  *
  * Copyright (c) 2026 STMicroelectronics.
  * All rights reserved.
  *
  * This software is licensed under terms that can be found in the LICENSE file
  * in the root directory of this software component.
  * If no LICENSE file comes with this software, it is provided AS-IS.
  *
  ******************************************************************************
  */

//M5748 Boot Loader v1.00 18/9/2024

/* USER CODE END Header */
#include "main.h"

/* USER CODE BEGIN Includes */
#include "flash_if.h"
/* USER CODE END Includes */

/* USER CODE BEGIN PTD */
typedef  void (*pFunction)(void);
pFunction JumpToApplication;
uint32_t JumpAddress;
/* USER CODE END PTD */

void SystemClock_Config(void);
static void MX_GPIO_Init(void);
/* USER CODE BEGIN PFP */
static int copyApplicationImage();
static void clearLength();
/* USER CODE END PFP */

int main(void)
{

  /* MCU Configuration--------------------------------------------------------*/

  /* Reset of all peripherals, Initializes the Flash interface and the Systick. */
  HAL_Init();

  /* Configure the system clock */
  SystemClock_Config();

  /* Initialize all configured peripherals */
  MX_GPIO_Init();
  /* USER CODE BEGIN 2 */
  int errorCode = checkFlashCrc(1);
 if (errorCode == 0)
  {
    //a valid image of the new firmware is present!
    if (copyApplicationImage() < 0)
    {
      while(1) {} //failed to copy the image - now the original firmware if probably corrupted
    }

  }
  else if (errorCode == ERROR_CRC)
  {
    //wrong CRC
    //delet the file length so the bootloader wont have to calculate CRC each time the application starts
    clearLength();
  }

  /* Test if user code is programmed starting from address "APPLICATION_ADDRESS" */
  if (((*(__IO uint32_t*)APPLICATION_ADDRESS) & 0x2FFE0000 ) == 0x20000000)
  {
    /* Jump to user application */
    JumpAddress = *(__IO uint32_t*) (APPLICATION_ADDRESS + 4);
    JumpToApplication = (pFunction) JumpAddress;
    /* Initialize user application's Stack Pointer */
    __set_MSP(*(__IO uint32_t*) APPLICATION_ADDRESS);
    JumpToApplication();
  }
  /* USER CODE END 2 */

  /* Infinite loop */
  while (1)
  {

  }
}

void SystemClock_Config(void)
{
  RCC_OscInitTypeDef RCC_OscInitStruct = {0};
  RCC_ClkInitTypeDef RCC_ClkInitStruct = {0};

  /** Initializes the RCC Oscillators according to the specified parameters
  * in the RCC_OscInitTypeDef structure.
  */
  RCC_OscInitStruct.OscillatorType = RCC_OSCILLATORTYPE_HSI;
  RCC_OscInitStruct.HSIState = RCC_HSI_ON;
  RCC_OscInitStruct.HSICalibrationValue = RCC_HSICALIBRATION_DEFAULT;
  RCC_OscInitStruct.PLL.PLLState = RCC_PLL_NONE;
  if (HAL_RCC_OscConfig(&RCC_OscInitStruct) != HAL_OK)
  {
    Error_Handler();
  }

  /** Initializes the CPU, AHB and APB buses clocks
  */
  RCC_ClkInitStruct.ClockType = RCC_CLOCKTYPE_HCLK|RCC_CLOCKTYPE_SYSCLK
                              |RCC_CLOCKTYPE_PCLK1|RCC_CLOCKTYPE_PCLK2;
  RCC_ClkInitStruct.SYSCLKSource = RCC_SYSCLKSOURCE_HSI;
  RCC_ClkInitStruct.AHBCLKDivider = RCC_SYSCLK_DIV1;
  RCC_ClkInitStruct.APB1CLKDivider = RCC_HCLK_DIV1;
  RCC_ClkInitStruct.APB2CLKDivider = RCC_HCLK_DIV1;

  if (HAL_RCC_ClockConfig(&RCC_ClkInitStruct, FLASH_LATENCY_0) != HAL_OK)
  {
    Error_Handler();
  }
}

static void MX_GPIO_Init(void)
{

  /* GPIO Ports Clock Enable */
  __HAL_RCC_GPIOA_CLK_ENABLE();

}

/* USER CODE BEGIN 4 */
static int copyApplicationImage()
{
  uint32_t length, count;

  FLASH_If_Init(); // Initialise Flash

  if (FLASH_If_Erase(APPLICATION_ADDRESS, APPLICATION_END_ADDRESS) != FLASHIF_OK) // erase Application flash area
    return -1;

  length = *((uint32_t *)USER_FLASH_LENGTH_ADDRESS);
  count = length/4;
  if ((length%4) != 0)
    count++;

  if (FLASH_If_Write(APPLICATION_ADDRESS, (uint32_t *)USER_FLASH_FIRST_PAGE_ADDRESS, count) != FLASHIF_OK) //copy new firmware from User Flase (image) area to the application area
    return -1;

  if (checkFlashCrc(0) < 0)
    return -1;

  length = 0;
  FLASH_If_Write(USER_FLASH_LENGTH_ADDRESS, &length, 1); //erase the length so on the next reset the image will not be copied again
  //FLASH_If_Erase(USER_FLASH_FIRST_PAGE_ADDRESS, USER_FLASH_END_ADDRESS); //erase the immage (just in case)

  return 0;
}

static void clearLength()
{
  uint32_t length;

  FLASH_If_Init(); // Initialise Flash
  length = 0;
  FLASH_If_Write(USER_FLASH_LENGTH_ADDRESS, &length, 1);
}
/* USER CODE END 4 */

void Error_Handler(void)
{
  __disable_irq();
  while (1)
  {
  }
}
